## boards/risc-v/hpm5300/hpm5300evk/Kconfig
```kconfig
#
# For a description of the syntax of this configuration file,
# see misc/tools/kconfig-language.txt.
#

if ARCH_BOARD_HPM5300EVK

config ARCH_BUTTONS
	bool "Board has buttons"
	default y

config ARCH_IRQBUTTONS
	bool "Board supports button interrupts"
	default y
	---help---
		The board provides the board_button_irq() interface.  Button
		presses and releases interrupt via the GPIO0 bank A interrupt
		(HPM_IRQ_GPIO0_A), configured for both edges on PA9.

endif
```

## boards/risc-v/hpm5300/hpm5300evk/configs/nsh/defconfig
```kconfig
#
CONFIG_ARCH_BOARD="hpm5300evk"
CONFIG_ARCH_BOARD_HPM5300EVK=y
CONFIG_ARCH_CHIP="hpm5300"
CONFIG_ARCH_CHIP_HPM5300IPA=y
CONFIG_ARCH_CHIP_HPM5300=y
CONFIG_ARCH_INTERRUPTSTACK=8192
CONFIG_ARCH="risc-v"
CONFIG_ARCH_RISCV=y
CONFIG_ARCH_STACKDUMP=y
CONFIG_BOARD_LOOPSPERMSEC=10000
CONFIG_BUILTIN=y
CONFIG_DEBUG_FEATURES=y
CONFIG_DEBUG_SYMBOLS=y
CONFIG_DEFAULT_SMALL=y
# CONFIG_DISABLE_ENVIRON is not set
# CONFIG_DISABLE_PTHREAD is not set
CONFIG_ENABLE_ALL_SIGNALS=y
CONFIG_EXAMPLES_BUTTONS=y
CONFIG_EXAMPLES_HELLO=y
CONFIG_EXAMPLES_LEDS=y
CONFIG_FILE_STREAM=y
CONFIG_FS_BINFS=y
# CONFIG_FS_PROCFS_EXCLUDE_BLOCKS is not set
# CONFIG_FS_PROCFS_EXCLUDE_ENVIRON is not set
# CONFIG_FS_PROCFS_EXCLUDE_MEMDUMP is not set
# CONFIG_FS_PROCFS_EXCLUDE_MEMINFO is not set
# CONFIG_FS_PROCFS_EXCLUDE_MOUNT is not set
# CONFIG_FS_PROCFS_EXCLUDE_MOUNTS is not set
# CONFIG_FS_PROCFS_EXCLUDE_PROCESS is not set
# CONFIG_FS_PROCFS_EXCLUDE_UPTIME is not set
# CONFIG_FS_PROCFS_EXCLUDE_USAGE is not set
# CONFIG_FS_PROCFS_EXCLUDE_VERSION is not set
CONFIG_FS_PROCFS=y
CONFIG_HPM_UART0=y
CONFIG_IDLETHREAD_STACKSIZE=8192
CONFIG_INIT_ENTRYPOINT="nsh_main"
CONFIG_INIT_STACKSIZE=8192
CONFIG_INPUT_BUTTONS_LOWER=y
CONFIG_INPUT_BUTTONS=y
CONFIG_INPUT=y
CONFIG_INTELHEX_BINARY=y
CONFIG_LIBC_ENVPATH=y
CONFIG_LIBC_PERROR_STDOUT=y
CONFIG_LIBC_STRERROR=y
CONFIG_NSH_BUILTIN_APPS=y
# CONFIG_NSH_DISABLEBG is not set
# CONFIG_NSH_DISABLE_CAT is not set
# CONFIG_NSH_DISABLE_CD is not set
# CONFIG_NSH_DISABLE_ECHO is not set
# CONFIG_NSH_DISABLE_ENV is not set
# CONFIG_NSH_DISABLE_EXEC is not set
# CONFIG_NSH_DISABLE_FREE is not set
# CONFIG_NSH_DISABLE_KILL is not set
# CONFIG_NSH_DISABLE_LOSMART is not set
# CONFIG_NSH_DISABLE_LS is not set
# CONFIG_NSH_DISABLE_MOUNT is not set
# CONFIG_NSH_DISABLE_PRINTF is not set
# CONFIG_NSH_DISABLE_PS is not set
# CONFIG_NSH_DISABLE_PWD is not set
# CONFIG_NSH_DISABLE_SLEEP is not set
# CONFIG_NSH_DISABLE_UNAME is not set
# CONFIG_NSH_DISABLE_USLEEP is not set
CONFIG_NSH_FILEIOSIZE=64
CONFIG_NSH_READLINE=y
CONFIG_NSH_STRERROR=y
CONFIG_RAM_SIZE=131072
CONFIG_RAM_START=0x00080000
CONFIG_READLINE_CMD_HISTORY=y
CONFIG_READLINE_EDIT=y
CONFIG_READLINE_TABCOMPLETION=y
CONFIG_RISCV_TOOLCHAIN_GNU_RV32=y
CONFIG_RR_INTERVAL=200
CONFIG_SCHED_HPWORK=y
CONFIG_SCHED_LPWORK=y
CONFIG_SCHED_WAITPID=y
CONFIG_SERIAL_TERMIOS=y
CONFIG_SIG_ALLOC_ACTIONS=1
CONFIG_SIG_PREALLOC_ACTIONS=4
# CONFIG_STANDARD_SERIAL is not set
CONFIG_START_DAY=7
CONFIG_START_MONTH=2
CONFIG_START_YEAR=2023
CONFIG_SYSTEM_NSH=y
CONFIG_UART0_SERIAL_CONSOLE=y
CONFIG_USERLED_LOWER=y
CONFIG_USERLED=y
CONFIG_WQUEUE_NOTIFIER=y
# modifications.
# This file is autogenerated: PLEASE DO NOT EDIT IT.
# You can then do "make savedefconfig" to generate a new defconfig file that includes your
# You can use "make menuconfig" to make any modifications to the installed .config file.
```
